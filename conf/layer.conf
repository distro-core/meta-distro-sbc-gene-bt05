## conf/layer.conf
```bitbake
# LAYER.conf

# Use in BBLAYERS.CONF following poky/meta and poky/meta-poky
# such that the prepend places this layer at the front of BBPATH

BBPATH =. "${LAYERDIR}:"

BBFILES += "${LAYERDIR}/recipes-*/*/*.bb ${LAYERDIR}/recipes-*/*/*.bbappend"

BBFILE_COLLECTIONS += "distro-sbc-gene-bt05"
BBFILE_PATTERN_distro-sbc-gene-bt05 = "^${LAYERDIR}/"
BBFILE_PRIORITY_distro-sbc-gene-bt05 = "12"

# Requied dependency layers that are present in every build
LAYERDEPENDS_distro-sbc-gene-bt05 = "distro-core"
LAYERSERIES_COMPAT_distro-sbc-gene-bt05 = "kirkstone scarthgap"
```
